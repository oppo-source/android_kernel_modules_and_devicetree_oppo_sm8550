/dts-v1/;
/plugin/;

#include "kalama-audio-atp.dtsi"
 / {
	model = "Qualcomm Technologies, Inc. Kalama ATP";
	compatible = "qcom,kalama-atp", "qcom,kalama", "qcom,atp", "qcom,kalamap";
	qcom,msm-id = <519 0x10000>, <536 0x10000>, <519 0x20000>, <536 0x20000>,
		<603 0x20000>, <604 0x20000>;
	qcom,board-id = <0x10021 0>;
};
