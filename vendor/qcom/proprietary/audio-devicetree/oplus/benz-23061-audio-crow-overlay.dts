/dts-v1/;
/plugin/;
#include <dt-bindings/oplus/hw-id.h>
#include "../crow-audio-qrd.dts"
#include "crow-audio-overlay-common.dtsi"
#include "benz-23061-audio-crow-overlay.dtsi"

/ {
    model = "Qualcomm Technologies, Inc. Crow QRD,Benz";

    oplus,project-id = <23061 23871>;
};