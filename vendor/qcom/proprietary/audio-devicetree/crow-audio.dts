/dts-v1/;
/plugin/;

#include <dt-bindings/clock/qcom,gcc-crow.h>
#include <dt-bindings/interrupt-controller/arm-gic.h>
#include <dt-bindings/interconnect/qcom,crow.h>
#include <dt-bindings/regulator/qcom,rpmh-regulator-levels.h>

#include "crow-audio.dtsi"

/ {
	model = "Qualcomm Technologies, Inc. crow";
	compatible = "qcom,crow", "qcom,crowp";
	qcom,msm-id = <608 0x10000>;
	qcom,board-id = <0 0>;
};
