&actuator_rear_wide {
	pid_version = <0x03>;
	pid_register = /bits/ 8 <0x45 0xAF
	0x48 0x10
	0x49 0x00
	0x4A 0x19
	0x4B 0x00
	0x4C 0x01
	0x4D 0x0A
	0x4E 0x20
	0x4F 0x00
	0x50 0x0B
	0x51 0xFC
	0x52 0x0A
	0x53 0xA6
	0x54 0x3A
	0x74 0x05
	0x75 0x58
	0x76 0x88
	0x77 0x20
	0x78 0x14
	0x79 0x14
	0x7A 0x30
	0x7B 0x00
	0x7C 0x00
	0x7D 0x10
	0x7E 0x03
	0x80 0x00
	0x81 0x00
	0x82 0x0D
	0x83 0xB4
	0x86 0x7A
	0x87 0x47
	0x88 0xC4
	0x89 0x20
	0x8A 0x3D
	0x8B 0xF1
	0x8C 0x85
	0x8D 0xB9
	0x8E 0x3D
	0x8F 0xF0
	0x90 0xCC
	0x91 0x7D
	0x92 0xA3
	0x93 0x55
	0x94 0x02
	0x95 0x00
	0x96 0x00
	0x97 0x0F
	0x98 0x80
	0x99 0x05
	0x9A 0x00
	0x9B 0x32
	0x9C 0xFF
	0x9D 0x00
	0x9E 0x10
	0x9F 0x10
	0xA0 0x00
	0xA1 0x00
	0xA2 0x80
	0xA3 0x80
	0xA8 0x10
	0xA9 0x00
	0xAA 0x00
	0xAB 0x00
	0xAC 0x10
	0x02 0x40
	>;
};