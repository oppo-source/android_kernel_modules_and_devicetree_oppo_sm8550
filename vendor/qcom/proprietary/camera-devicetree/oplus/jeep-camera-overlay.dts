/dts-v1/;
/plugin/;

#include <dt-bindings/clock/qcom,gcc-crow.h>
#include <dt-bindings/clock/qcom,camcc-crow.h>
#include <dt-bindings/interconnect/qcom,crow.h>
#include <dt-bindings/interrupt-controller/arm-gic.h>
#include <dt-bindings/regulator/qcom,rpmh-regulator-levels.h>

#include "regulator/aw37004.dtsi"
#include "jeep_camera_overlay_common.dtsi"
#include "jeep_camera_main_actuator_pid.dtsi"
/ {
	model = "Qualcomm Technologies, Inc. Crow QRD,Jeep";
	compatible = "qcom,crow";
	qcom,msm-id = <608 0x10000>;
	qcom,board-id = <11 0>;
	oplus,project-id = <24061>;
};