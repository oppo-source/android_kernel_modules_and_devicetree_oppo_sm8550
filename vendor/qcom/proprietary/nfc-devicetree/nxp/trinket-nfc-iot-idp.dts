/dts-v1/;
/plugin/;

#include "trinket-nfc-pinctrl.dtsi"
#include "trinket-nfc-common.dtsi"
/ {
    model = "Qualcomm Technologies, Inc. TRINKET IOT IDP SoC";
    compatible = "qcom,trinket-iot-idp", "qcom,trinket-iot", "qcom,idp";
    qcom,msm-id = <467 0x10000>, <468 0x10000>;
    qcom,board-id = <34 0>;
};
